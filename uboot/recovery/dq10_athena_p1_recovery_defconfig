## uboot/recovery/dq10_athena_p1_recovery_defconfig
```kconfig
CONFIG_ARM=y
CONFIG_ARCH_SUNXI=y
CONFIG_DEFAULT_DEVICE_TREE="allwinner/sun50i-h313-dq10-recovery"
CONFIG_DRAM_CLK=600
CONFIG_SPL=y
CONFIG_DRAM_SUNXI_DX_ODT=0x06060606
CONFIG_DRAM_SUNXI_DX_DRI=0x0d0d0d0d
CONFIG_DRAM_SUNXI_CA_DRI=0x0d0d
CONFIG_DRAM_SUNXI_TPR6=0x2fa88080
CONFIG_DRAM_SUNXI_TPR10=0x002f3359
CONFIG_DRAM_SUNXI_TPR11=0xaa889967
CONFIG_DRAM_SUNXI_TPR12=0xeeee8979
CONFIG_MACH_SUN50I_H616=y
CONFIG_SUNXI_DRAM_H616_LPDDR3=y
CONFIG_MMC_SUNXI_SLOT_EXTRA=2
CONFIG_R_I2C_ENABLE=y
CONFIG_SPL_SUNXI_LED_STATUS=y
CONFIG_SPL_SUNXI_LED_STATUS_GPIO=230
# CONFIG_SYS_MALLOC_CLEAR_ON_INIT is not set
CONFIG_SPL_I2C=y
CONFIG_SPL_SYS_I2C_LEGACY=y
CONFIG_SYS_I2C_MVTWSI=y
CONFIG_SYS_I2C_SLAVE=0x7f
CONFIG_SYS_I2C_SPEED=400000
CONFIG_SUPPORT_EMMC_BOOT=y
CONFIG_AXP313_POWER=y
CONFIG_AXP_DCDC3_VOLT=1200
CONFIG_USB_EHCI_HCD=y
CONFIG_USB_OHCI_HCD=y
CONFIG_USB_MUSB_GADGET=y
CONFIG_USB_GADGET=y
CONFIG_USB_GADGET_DOWNLOAD=y
CONFIG_USB_GADGET_VENDOR_NUM=0x1f3a
CONFIG_USB_GADGET_PRODUCT_NUM=0x1010
CONFIG_CMD_USB_MASS_STORAGE=y
CONFIG_USB_FUNCTION_MASS_STORAGE=y
CONFIG_USE_BOOTCOMMAND=y
CONFIG_BOOTCOMMAND="echo DQ10-RECOVERY; mmc dev 1; ums 0 mmc 1"
```
